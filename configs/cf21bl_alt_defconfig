## configs/cf21bl_alt_defconfig
```kconfig
CONFIG_PLATFORM_CF21BL=y

CONFIG_MOTORS_REQUIRE_ARMING=y
CONFIG_MOTORS_ESC_PROTOCOL_DSHOT=y

CONFIG_DECK_ADHOCDECK_USE_ALT_PINS=y

# CONFIG_DECK_FLOW=n
# CONFIG_DECK_LIGHTHOUSE=n
# CONFIG_DECK_COLORLED=n
# CONFIG_DECK_RP=n
```

## configs/cf21bl_uart2_defconfig
```kconfig
CONFIG_PLATFORM_CF21BL=y

CONFIG_MOTORS_REQUIRE_ARMING=y
CONFIG_MOTORS_ESC_PROTOCOL_DSHOT=y

CONFIG_DECK_ADHOCDECK_USE_UART2_PINS=y
```
